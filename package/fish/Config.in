## package/fish/Config.in
```kconfig
config BR2_PACKAGE_FISH
	bool "fish"
	depends on BR2_USE_MMU # fork()
	depends on BR2_PACKAGE_BUSYBOX_SHOW_OTHERS
	select BR2_PACKAGE_NCURSES
	help
      fish is a smart and user-friendly command line shell for OS X, Linux,
      and the rest of the family. fish includes features like syntax
      highlighting, autosuggest-as-you-type, and fancy tab completions that
      just work, with no configuration required.

      https://fishshell.com
```
